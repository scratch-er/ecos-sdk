## src/configs/Kconfig
```kconfig
mainmenu "ECOS Embedded SDK Configuration"

menu "Target Hardware Configuration"
    choice
        prompt "Target SoC Platform"
        default SOC_RETROSOC
        
    config SOC_RETROSOC
        bool "RetroSoC Platform"
        help
          RetroSoC RISC-V based embedded platform
    endchoice
    
    config SOC_NAME
        string
        default "retrosoc" if SOC_RETROSOC
        
    config ARCH_RISCV32
        bool
        default y if SOC_RETROSOC
        
endmenu

menu "System Configuration"
    config CPU_FREQ_MHZ
        int "CPU Frequency (MHz)"
        default 72
        range 1 200
    config UART_BAUD_RATE
        int "UART Baud Rate"
        default 115200
        range 1 1000000
    config PSRAM_NUM
        int "Number of PSRAM Chips"
        default 1
        range 1 4
    config PSRAM_SCLK_MIN_FREQ_MHZ
        int "PSRAM SCLK Minimum Frequency (MHz)"
        default 12
        range 1 200
    config PSRAM_SCLK_MAX_FREQ_MHZ
        int "PSRAM SCLK Maximum Frequency (MHz)"
        default 133
        range 1 200
endmenu

menu "Peripheral Drivers"
    config DRIVER_UART
        bool "UART Driver Support"
        default y
        help
          Enable UART driver for serial communication
          
    config DRIVER_GPIO
        bool "GPIO Driver Support" 
        default y
        help
          Enable GPIO driver for pin control
          
    config DRIVER_SPI
        bool "SPI Driver Support"
        default y
        help
          Enable SPI driver for serial peripheral interface
          
    config DRIVER_I2C
        bool "I2C Driver Support"
        default y
        help
          Enable I2C driver for inter-integrated circuit
          
    config DRIVER_PWM
        bool "PWM Driver Support"
        default y
        help
          Enable PWM driver for pulse width modulation
          
    config DRIVER_TIMER
        bool "Timer Driver Support"
        default y
        help
          Enable timer driver for timing functions
endmenu

menu "Build Configuration"
    choice
        prompt "Optimization Level"
        default BUILD_OPT_SIZE
        
    config BUILD_OPT_NONE
        bool "No optimization (-O0)"
        
    config BUILD_OPT_SIZE
        bool "Optimize for size (-Os)"
        
    config BUILD_OPT_SPEED
        bool "Optimize for speed (-O2)"
        
    config BUILD_OPT_MAX
        bool "Maximum optimization (-O3)"
    endchoice
    
    config BUILD_OPT_FLAGS
        string
        default "-O0" if BUILD_OPT_NONE
        default "-Os" if BUILD_OPT_SIZE  
        default "-O2" if BUILD_OPT_SPEED
        default "-O3" if BUILD_OPT_MAX
        
    config BUILD_DEBUG
        bool "Enable debug information"
        default n
        help
          Add debug symbols to the firmware
          
    config BUILD_VERBOSE
        bool "Verbose build output"
        default n
        help
          Show detailed compilation commands
endmenu

menu "Firmware Configuration"
    config FIRMWARE_NAME
        string "Firmware name"
        default "retrosoc_fw"
        help
          Name of the generated firmware file
          
    config FIRMWARE_VERSION
        string "Firmware version"
        default "1.0.0"
        help
          Version string for the firmware
          
endmenu
```

## tools/kconfig/Kconfig
```kconfig
mainmenu "ECOS Embedded SDK Configuration"

menu "Target Hardware Configuration"
    choice
        prompt "Target SoC Platform"
        default STARRYSKY_C1
        
    config STARRYSKY_C1
        bool "StarrySky_C1 Platform"
        help
          StarrySky_C1 RISC-V based embedded platform

    config STARRYSKY_L3
        bool "StarrySky_L3 Platform"
        help
          StarrySky_L3 RISC-V based embedded platform
    endchoice
    
    config BOARD_NAME
        string
        default "starrysky_c1" if STARRYSKY_C1
        default "starrysky_l3" if STARRYSKY_L3
        
    config ARCH_RISCV32
        bool
        default y if STARRYSKY_C1 

    config ARCH_RISCV64
        bool
        default y if STARRYSKY_L3

    config GPIO_IP_ID
        int
        default 0 if STARRYSKY_C1
        default 1 if STARRYSKY_L3
endmenu

menu "System Configuration"
    config CPU_FREQ_MHZ
        int "CPU Frequency (MHz)"
        default 72
        range 1 200
    config UART_BAUD_RATE
        int "UART Baud Rate"
        default 115200
        range 1 1000000
    config PSRAM_NUM
        int "Number of PSRAM Chips"
        default 1
        range 1 4
    config PSRAM_SCLK_MIN_FREQ_MHZ
        int "PSRAM SCLK Minimum Frequency (MHz)"
        default 12
        range 1 200
    config PSRAM_SCLK_MAX_FREQ_MHZ
        int "PSRAM SCLK Maximum Frequency (MHz)"
        default 133
        range 1 200
endmenu

menu "Peripheral Drivers"
    config DRIVER_UART
        bool "UART Driver Support"
        default y
        help
          Enable UART driver for serial communication
          
    config DRIVER_GPIO
        bool "GPIO Driver Support" 
        default y
        help
          Enable GPIO driver for pin control
          
    config DRIVER_SPI
        bool "SPI Driver Support"
        default y
        help
          Enable SPI driver for serial peripheral interface
          
    config DRIVER_I2C
        bool "I2C Driver Support"
        default y
        help
          Enable I2C driver for inter-integrated circuit
          
    config DRIVER_PWM
        bool "PWM Driver Support"
        default y
        help
          Enable PWM driver for pulse width modulation
          
    config DRIVER_TIMER
        bool "Timer Driver Support"
        default y
        help
          Enable timer driver for timing functions
endmenu

menu "Build Configuration"
    choice
        prompt "Optimization Level"
        default BUILD_OPT_SIZE
        
    config BUILD_OPT_NONE
        bool "No optimization (-O0)"
        
    config BUILD_OPT_SIZE
        bool "Optimize for size (-Os)"
        
    config BUILD_OPT_SPEED
        bool "Optimize for speed (-O2)"
        
    config BUILD_OPT_MAX
        bool "Maximum optimization (-O3)"
    endchoice
    
    config BUILD_OPT_FLAGS
        string
        default "-O0" if BUILD_OPT_NONE
        default "-Os" if BUILD_OPT_SIZE  
        default "-O2" if BUILD_OPT_SPEED
        default "-O3" if BUILD_OPT_MAX
        
    config BUILD_DEBUG
        bool "Enable debug information"
        default n
        help
          Add debug symbols to the firmware
          
    config BUILD_VERBOSE
        bool "Verbose build output"
        default n
        help
          Show detailed compilation commands
endmenu

menu "Firmware Configuration"
    config FIRMWARE_NAME
        string "Firmware name"
        default "retrosoc_fw"
        help
          Name of the generated firmware file
          
    config FIRMWARE_VERSION
        string "Firmware version"
        default "1.0.0"
        help
          Version string for the firmware
          
endmenu
```
